## boards/shields/cowboard_right/Kconfig.defconfig
```kconfig
if SHIELD_RCOWBOARD

config ZMK_KEYBOARD_NAME
    default "Cowboard Right"

endif
```

## config/boards/shields/cowboard-right/Kconfig.defconfig
```kconfig
if SHIELD_COWBOARD_RIGHT

config ZMK_KEYBOARD_NAME
    default "Cowboard Right"

endif
```

## config/boards/shields/cowboard-right/Kconfig.shield
```kconfig
config SHIELD_COWBOARD_RIGHT
    def bool $(shields_list_contains, cowboard_right)
```
